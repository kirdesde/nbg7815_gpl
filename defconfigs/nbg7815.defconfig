## defconfigs/nbg7815.defconfig
```kconfig
CONFIG_TARGET_ipq=y
CONFIG_TARGET_ipq_ipq807x_64=y
CONFIG_TARGET_ipq_ipq807x_64_QSDK_Premium=y
CONFIG_DEVEL=y
CONFIG_TOOLCHAINOPTS=y
CONFIG_BUSYBOX_CUSTOM=y
CONFIG_BUSYBOX_CONFIG_ADDUSER=y
CONFIG_BUSYBOX_CONFIG_DELUSER=y
CONFIG_BUSYBOX_CONFIG_FEATURE_GETOPT_LONG=y
CONFIG_BUSYBOX_CONFIG_FEATURE_SEAMLESS_XZ=y
CONFIG_BUSYBOX_CONFIG_FEATURE_TAR_LONG_OPTIONS=y
CONFIG_BUSYBOX_CONFIG_FIRST_SYSTEM_ID=100
CONFIG_BUSYBOX_CONFIG_GETOPT=y
CONFIG_BUSYBOX_CONFIG_GETTY=y
CONFIG_BUSYBOX_CONFIG_LAST_ID=999
CONFIG_BUSYBOX_CONFIG_LAST_SYSTEM_ID=999
CONFIG_BUSYBOX_CONFIG_LOGIN=y
CONFIG_BUSYBOX_CONFIG_UNXZ=y
CONFIG_BUSYBOX_CONFIG_UNZIP=y
CONFIG_BUSYBOX_CONFIG_WATCH=y
CONFIG_BUSYBOX_CONFIG_XZ=y
CONFIG_COLLECT_KERNEL_DEBUG=y
# CONFIG_GCC_USE_VERSION_4_8_LINARO is not set
CONFIG_GCC_USE_VERSION_5=y
CONFIG_GCC_VERSION="5.2.0"
CONFIG_GCC_VERSION_5=y
CONFIG_GIT_MIRROR="git://codeaurora.org/quic/qsdk/"
CONFIG_KERNEL_BLK_CGROUP=y
# CONFIG_KERNEL_CC_STACKPROTECTOR_NONE is not set
CONFIG_KERNEL_CC_STACKPROTECTOR_REGULAR=y
CONFIG_KERNEL_CFS_BANDWIDTH=y
CONFIG_KERNEL_CGROUPS=y
CONFIG_KERNEL_CGROUP_CPUACCT=y
CONFIG_KERNEL_CGROUP_DEVICE=y
CONFIG_KERNEL_CGROUP_FREEZER=y
CONFIG_KERNEL_CGROUP_PIDS=y
CONFIG_KERNEL_CGROUP_SCHED=y
CONFIG_KERNEL_CPUSETS=y
# CONFIG_KERNEL_DEBUG_INFO_REDUCED is not set
CONFIG_KERNEL_DEVPTS_MULTIPLE_INSTANCES=y
CONFIG_KERNEL_DIRECT_IO=y
CONFIG_KERNEL_DYNAMIC_DEBUG=y
CONFIG_KERNEL_FAIR_GROUP_SCHED=y
CONFIG_KERNEL_FREEZER=y
CONFIG_KERNEL_IPC_NS=y
CONFIG_KERNEL_LXC_MISC=y
CONFIG_KERNEL_MEMCG=y
CONFIG_KERNEL_MEMCG_KMEM=y
CONFIG_KERNEL_MM_OWNER=y
CONFIG_KERNEL_NAMESPACES=y
CONFIG_KERNEL_NETPRIO_CGROUP=y
CONFIG_KERNEL_NET_CLS_CGROUP=y
CONFIG_KERNEL_NET_NS=y
CONFIG_KERNEL_PID_NS=y
CONFIG_KERNEL_POSIX_MQUEUE=y
CONFIG_KERNEL_RESOURCE_COUNTERS=y
CONFIG_KERNEL_RT_GROUP_SCHED=y
# CONFIG_KERNEL_SWAP is not set
CONFIG_KERNEL_USER_NS=y
CONFIG_KERNEL_UTS_NS=y
CONFIG_LIBC="musl"
# CONFIG_LIBC_USE_GLIBC is not set
CONFIG_LIBC_USE_MUSL=y
CONFIG_LIBC_VERSION="1.1.16"
CONFIG_LIGHTTPD_SSL=y
CONFIG_LLDPD_WITH_CDP=y
CONFIG_LLDPD_WITH_CUSTOM=y
CONFIG_LLDPD_WITH_DOT1=y
CONFIG_LLDPD_WITH_DOT3=y
CONFIG_LLDPD_WITH_EDP=y
CONFIG_LLDPD_WITH_FDP=y
CONFIG_LLDPD_WITH_LLDPMED=y
CONFIG_LLDPD_WITH_PRIVSEP=y
CONFIG_LLDPD_WITH_SONMP=y
CONFIG_LOCALMIRROR="http://172.21.83.131/file/WIFI_DL/"
CONFIG_LXC_BUSYBOX_OPTIONS=y
CONFIG_LXC_KERNEL_OPTIONS=y
CONFIG_MUSL_VERSION="1.1.16"
# CONFIG_PACKAGE_464xlat is not set
CONFIG_PACKAGE_6in4=y
CONFIG_PACKAGE_6to4=y
CONFIG_PACKAGE_FWBuildNumber=y
# CONFIG_PACKAGE_alsa is not set
# CONFIG_PACKAGE_alsa-utils is not set
CONFIG_PACKAGE_ar=m
CONFIG_PACKAGE_binutils=m
CONFIG_PACKAGE_bluez-libs=y
CONFIG_PACKAGE_bluez-utils=y
CONFIG_PACKAGE_ca-certificates=y
CONFIG_PACKAGE_conntrack-tools=y
CONFIG_PACKAGE_coreutils=m
CONFIG_PACKAGE_coreutils-stty=m
CONFIG_PACKAGE_cryptsetup=m
CONFIG_PACKAGE_curl=y
CONFIG_PACKAGE_data-release=y
CONFIG_PACKAGE_dcmp-server=y
# CONFIG_PACKAGE_ddns-scripts is not set
# CONFIG_PACKAGE_ds-lite is not set
CONFIG_PACKAGE_easycwmp=m
CONFIG_PACKAGE_ebtables=y
CONFIG_PACKAGE_fcgi=y
CONFIG_PACKAGE_fdisk=m
CONFIG_PACKAGE_ffmpeg=y
CONFIG_PACKAGE_ffprobe=y
# CONFIG_PACKAGE_firewall is not set
CONFIG_PACKAGE_flock=y
CONFIG_PACKAGE_gdb=m
CONFIG_PACKAGE_glib2=y
CONFIG_PACKAGE_igmpproxy=y
CONFIG_PACKAGE_iozone=m
CONFIG_PACKAGE_iperf3=m
CONFIG_PACKAGE_iptables-mod-mark2prio=y
CONFIG_PACKAGE_iptables-mod-nat-extra=y
CONFIG_PACKAGE_iptables-mod-porttrigger=y
CONFIG_PACKAGE_iputils-ping=m
CONFIG_PACKAGE_iputils-ping6=m
# CONFIG_PACKAGE_isc-dhcp-relay-ipv6 is not set
CONFIG_PACKAGE_iw=y
CONFIG_PACKAGE_jansson=y
CONFIG_PACKAGE_kmod-block2mtd=m
CONFIG_PACKAGE_kmod-bluetooth=y
CONFIG_PACKAGE_kmod-bridge=y
CONFIG_PACKAGE_kmod-cfg80211-linux=y
CONFIG_PACKAGE_kmod-crypto-aes=m
CONFIG_PACKAGE_kmod-crypto-qce=m
CONFIG_PACKAGE_kmod-crypto-test=m
CONFIG_PACKAGE_kmod-dm=m
CONFIG_PACKAGE_kmod-e1000e=m
CONFIG_PACKAGE_kmod-ebtables=y
CONFIG_PACKAGE_kmod-ebtables-ipv4=m
CONFIG_PACKAGE_kmod-ebtables-ipv6=m
CONFIG_PACKAGE_kmod-fw-auth-test=m
CONFIG_PACKAGE_kmod-gpio-pcf857x=m
CONFIG_PACKAGE_kmod-gre6=y
CONFIG_PACKAGE_kmod-hid=y
CONFIG_PACKAGE_kmod-input-evdev=y
CONFIG_PACKAGE_kmod-ipt-mark2prio=y
CONFIG_PACKAGE_kmod-ipt-nat-extra=y
CONFIG_PACKAGE_kmod-ipt-porttrigger=y
CONFIG_PACKAGE_kmod-lib-crc16=y
CONFIG_PACKAGE_kmod-llc=y
CONFIG_PACKAGE_kmod-mtdtests=m
CONFIG_PACKAGE_kmod-nf-conntrack-netlink=y
CONFIG_PACKAGE_kmod-nfnetlink=y
CONFIG_PACKAGE_kmod-nfnetlink-queue=y
CONFIG_PACKAGE_kmod-pktgen=y
CONFIG_PACKAGE_kmod-pps=m
CONFIG_PACKAGE_kmod-ptp=m
CONFIG_PACKAGE_kmod-qseecom=m
CONFIG_PACKAGE_kmod-stp=y
CONFIG_PACKAGE_kmod-test-udelay=m
CONFIG_PACKAGE_kmod-usb-chipidea-qti=m
CONFIG_PACKAGE_kmod-usb-phy-ci-qti=m
CONFIG_PACKAGE_kmod-usb-printer=y
CONFIG_PACKAGE_kmod-veth=m
CONFIG_PACKAGE_libattr=y
CONFIG_PACKAGE_libbfd=y
CONFIG_PACKAGE_libblkid=m
CONFIG_PACKAGE_libbz2=y
CONFIG_PACKAGE_libcap=m
CONFIG_PACKAGE_libcares=y
CONFIG_PACKAGE_libcurl=y
CONFIG_PACKAGE_libdbus=y
CONFIG_PACKAGE_libdevmapper=m
CONFIG_PACKAGE_libdw=m
CONFIG_PACKAGE_libelf1=m
CONFIG_PACKAGE_libevent=y
CONFIG_PACKAGE_libevent2=y
CONFIG_PACKAGE_libexif=y
CONFIG_PACKAGE_libexpat=y
CONFIG_PACKAGE_libffi=y
CONFIG_PACKAGE_libffmpeg-full=y
CONFIG_PACKAGE_libflac=y
CONFIG_PACKAGE_libgcrypt=m
CONFIG_PACKAGE_libgpg-error=m
CONFIG_PACKAGE_libid3tag=y
CONFIG_PACKAGE_libiwinfo=y
CONFIG_PACKAGE_libiwinfo-lua=y
CONFIG_PACKAGE_libjpeg=y
CONFIG_PACKAGE_liblua=y
CONFIG_PACKAGE_liblxc=m
CONFIG_PACKAGE_liblzo=y
CONFIG_PACKAGE_libmesode=y
CONFIG_PACKAGE_libmicroxml=m
CONFIG_PACKAGE_libmnl=y
CONFIG_PACKAGE_libnetfilter-conntrack=y
CONFIG_PACKAGE_libnetfilter-cthelper=y
CONFIG_PACKAGE_libnetfilter-cttimeout=y
CONFIG_PACKAGE_libnetfilter-queue=y
CONFIG_PACKAGE_libnfnetlink=y
CONFIG_PACKAGE_libnghttp2=y
CONFIG_PACKAGE_libnl=y
CONFIG_PACKAGE_libogg=y
CONFIG_PACKAGE_libopcodes=m
CONFIG_PACKAGE_libpam=y
CONFIG_PACKAGE_libpcre=y
CONFIG_PACKAGE_libpolarssl=y
CONFIG_PACKAGE_libpopt=y
CONFIG_PACKAGE_libreadline=y
CONFIG_PACKAGE_libsmartcols=m
CONFIG_PACKAGE_libsqlite3=y
CONFIG_PACKAGE_libssp=y
CONFIG_PACKAGE_libubox-lua=y
CONFIG_PACKAGE_libubus-lua=y
CONFIG_PACKAGE_libuci-lua=y
CONFIG_PACKAGE_libvorbis=y
CONFIG_PACKAGE_libxml2=y
CONFIG_PACKAGE_lighttpd=y
CONFIG_PACKAGE_lighttpd-mod-access=y
CONFIG_PACKAGE_lighttpd-mod-alias=y
CONFIG_PACKAGE_lighttpd-mod-auth=y
CONFIG_PACKAGE_lighttpd-mod-cgi=y
CONFIG_PACKAGE_lighttpd-mod-fastcgi=y
CONFIG_PACKAGE_lighttpd-mod-magnet=y
CONFIG_PACKAGE_lighttpd-mod-redirect=y
CONFIG_PACKAGE_lighttpd-mod-rewrite=y
CONFIG_PACKAGE_lighttpd-mod-setenv=y
CONFIG_PACKAGE_lighttpd-mod-userdir=y
CONFIG_PACKAGE_linuxptp=m
CONFIG_PACKAGE_lldpd=y
CONFIG_PACKAGE_lrzsz=m
CONFIG_PACKAGE_lua=y
CONFIG_PACKAGE_luafilesystem=m
CONFIG_PACKAGE_lvm2=m
CONFIG_PACKAGE_lxc=y
CONFIG_PACKAGE_lxc-attach=m
CONFIG_PACKAGE_lxc-cgroup=m
CONFIG_PACKAGE_lxc-common=m
CONFIG_PACKAGE_lxc-configs=m
CONFIG_PACKAGE_lxc-create=m
CONFIG_PACKAGE_lxc-destroy=m
CONFIG_PACKAGE_lxc-hooks=m
CONFIG_PACKAGE_lxc-info=m
CONFIG_PACKAGE_lxc-lua=m
CONFIG_PACKAGE_lxc-monitord=m
CONFIG_PACKAGE_lxc-start=m
CONFIG_PACKAGE_lxc-stop=m
CONFIG_PACKAGE_lxc-templates=m
CONFIG_PACKAGE_mdadm=m
CONFIG_PACKAGE_minicom=m
CONFIG_PACKAGE_minidlna=y
CONFIG_PACKAGE_miniupnpd=y
CONFIG_PACKAGE_mkdosfs=m
CONFIG_PACKAGE_nand-utils=m
CONFIG_PACKAGE_nbtscan=y
CONFIG_PACKAGE_ntfsprogs_ntfs-3g=m
CONFIG_PACKAGE_ntpclient=y
CONFIG_PACKAGE_objdump=m
# CONFIG_PACKAGE_odhcp6c is not set
# CONFIG_PACKAGE_odhcpd is not set
CONFIG_PACKAGE_p910nd=y
CONFIG_PACKAGE_perf=m
# CONFIG_PACKAGE_ppp-mod-pppol2tp is not set
CONFIG_PACKAGE_proftpd=y
CONFIG_PACKAGE_px5g=y
CONFIG_PACKAGE_radvd=y
CONFIG_PACKAGE_radvdump=y
CONFIG_PACKAGE_remserial=m
# CONFIG_PACKAGE_rp-pppoe-server is not set
CONFIG_PACKAGE_rpcd=y
CONFIG_PACKAGE_rpcd-mod-lxc=m
CONFIG_PACKAGE_samba3=y
CONFIG_PACKAGE_samba3-nmbd=y
CONFIG_PACKAGE_shadow-common=m
CONFIG_PACKAGE_shadow-useradd=m
CONFIG_PACKAGE_shadow-userdel=m
CONFIG_PACKAGE_shadow-utils=m
CONFIG_PACKAGE_strace=y
CONFIG_PACKAGE_stress=m
CONFIG_PACKAGE_uclibcxx=y
CONFIG_PACKAGE_updatedd=y
CONFIG_PACKAGE_updatedd-mod-dyndns=y
CONFIG_PACKAGE_updatedd-mod-eurodyndns=y
CONFIG_PACKAGE_updatedd-mod-noip=y
CONFIG_PACKAGE_updatedd-mod-regfish=y
CONFIG_PACKAGE_valgrind=m
CONFIG_PACKAGE_vsftpd=y
CONFIG_PACKAGE_wide-dhcpv6-client=y
CONFIG_PACKAGE_wide-dhcpv6-relay=y
CONFIG_PACKAGE_wide-dhcpv6-server=y
CONFIG_PACKAGE_wireless-tools=y
CONFIG_PACKAGE_wol=y
# CONFIG_PACKAGE_xl2tpd is not set
CONFIG_PACKAGE_zip=y
# CONFIG_PKG_CC_STACKPROTECTOR_NONE is not set
CONFIG_PKG_CC_STACKPROTECTOR_REGULAR=y
CONFIG_PKG_FORTIFY_SOURCE_2=y
# CONFIG_PKG_FORTIFY_SOURCE_NONE is not set
CONFIG_PKG_RELRO_FULL=y
# CONFIG_PKG_RELRO_NONE is not set
CONFIG_SAMBA3_CONFIG_SMALLER=y
CONFIG_SQLITE_FTS3=y
CONFIG_SQLITE_RTREE=y
CONFIG_SSP_SUPPORT=y
CONFIG_TARGET_INITRAMFS_COMPRESSION_LZMA=y
CONFIG_TARGET_ROOTFS_INITRAMFS=y
CONFIG_TARGET_SUFFIX="musl"
# CONFIG_USE_LIBSTDCXX is not set
CONFIG_USE_MUSL=y
CONFIG_USE_UCLIBCXX=y
CONFIG_WPA_MSG_MIN_PRIORITY=0
CONFIG_ZYXEL=y
CONFIG_ZYXEL_FORCE_DOWNLOAD_DEFAULT=y
CONFIG_ZYXEL_PROJECT_NAME="NBG7815"
CONFIG_ZYXEL_PROJECT_VERSION="V1.00(ABSK.3)C0_GPL"
# CONFIG_PACKAGE_shadow-chage is not set
# CONFIG_PACKAGE_shadow-groupadd is not set
# CONFIG_PACKAGE_shadow-groupdel is not set
# CONFIG_PACKAGE_shadow-groupmod is not set
# CONFIG_PACKAGE_shadow-groups is not set
# CONFIG_PACKAGE_shadow-passwd is not set
# CONFIG_PACKAGE_shadow-su is not set
# CONFIG_PACKAGE_shadow-usermod is not set
# CONFIG_shadow-all is not set
```

## qca/src/u-boot-2016/Kconfig.zyxel
```kconfig
menu "Zyxel configuration"

config ZYXEL
	bool "Zyxel products"
	default n

config ZYXEL_ETHADDR
	bool "use ethaddr variable not from ART"
	depends on ZYXEL
	default n
	help
	  Use ethaddr environment not from ART if it is available.

config ZYXEL_LED
	bool "zyxel LED support"
	depends on ZYXEL
	default n

config ZYXEL_LED_LP5562
	bool "LP5562 driver"
	depends on ZYXEL_LED
	default n

config ZYXEL_LED_LP5569
	bool "LP5569 twin drivers"
	depends on ZYXEL_LED
	default n

endmenu
```

## qca/src/u-boot-2016/configs/ipq807x_zyxel_defconfig
```kconfig
CONFIG_ARM=y
CONFIG_ARCH_IPQ807x=y
CONFIG_USB_XHCI_IPQ=y
CONFIG_PCI_IPQ=y
CONFIG_IPQ807x_I2C=y
CONFIG_QCA_AQUANTIA_PHY=y
CONFIG_QCA8033_PHY=y
CONFIG_QCA8081_PHY=y
CONFIG_QCA8075_PHY=y
CONFIG_ZYXEL=y
CONFIG_ZYXEL_ETHADDR=y
CONFIG_ZYXEL_LED=y
CONFIG_ZYXEL_LED_LP5569=y
CONFIG_FIT=y
CONFIG_FIT_VERBOSE=y
CONFIG_SYS_PROMPT="ZYXEL# "
# CONFIG_CMD_CONSOLE is not set
# CONFIG_CMD_BOOTD is not set
# CONFIG_CMD_ELF is not set
# CONFIG_CMD_RUN is not set
# CONFIG_CMD_IMI is not set
# CONFIG_CMD_IMLS is not set
# CONFIG_CMD_XIMG is not set
# CONFIG_CMD_EXPORTENV is not set
# CONFIG_CMD_IMPORTENV is not set
# CONFIG_CMD_EDITENV is not set
# CONFIG_CMD_ENV_EXISTS is not set
# CONFIG_CMD_FPGA is not set
# CONFIG_CMD_SETEXPR is not set
# CONFIG_CMD_NFS is not set
CONFIG_PARTITION_UUIDS=y
CONFIG_OF_CONTROL=y
CONFIG_USB=y
CONFIG_DM_USB=y
# CONFIG_REGEX is not set
```

## target/linux/ipq/ipq807x_64/prebuilt_images/fit-zyxel.its
```
/dts-v1/;

/ {
        description = "Zyxel Firmware";

        images {

                sbl1 {
                        description = "sbl1_nor.mbn";
                        data = /incbin/("./sbl1_nor.mbn");
                        type = "firmware";
                        arch = "arm";
                        compression = "none";
                        hash@1 { algo = "crc32"; };
                };

                qsee {
                        description = "tz.mbn";
                        data = /incbin/("./tz.mbn");
                        type = "firmware";
                        arch = "arm";
                        compression = "none";
                        hash@1 { algo = "crc32"; };
                };

                devcfg {
                        description = "devcfg.mbn";
                        data = /incbin/("./devcfg.mbn");
                        type = "firmware";
                        arch = "arm";
                        compression = "none";
                        hash@1 { algo = "crc32"; };
                };

                rpm {
                        description = "rpm.mbn";
                        data = /incbin/("./rpm.mbn");
                        type = "firmware";
                        arch = "arm";
                        compression = "none";
                        hash@1 { algo = "crc32"; };
                };

                cdt-NBG7815 {
                        description = "cdt-NBG7815_256M32_DDR3.bin";
                        data = /incbin/("./cdt-NBG7815_256M32_DDR3.bin");
                        type = "firmware";
                        arch = "arm";
                        compression = "none";
                        hash@1 { algo = "crc32"; };
                };

                ethphyfw {
                        description = "AQR_ethphyfw.mbn";
                        data = /incbin/("./AQR_ethphyfw.mbn");
                        type = "firmware";
                        arch = "arm";
                        compression = "none";
                        hash@1 { algo = "crc32"; };
                };

                u-boot {
                        description = "openwrt-ipq807x-u-boot.mbn";
                        data = /incbin/("./openwrt-ipq807x-u-boot.mbn");
                        type = "firmware";
                        arch = "arm";
                        compression = "none";
                        hash@1 { algo = "crc32"; };
                };

                hlos {
                        description = "openwrt-ipq-ipq807x_64-qcom-ipq807x-zyxel-fit-uImage.itb.padded";
                        data = /incbin/("./openwrt-ipq-ipq807x_64-qcom-ipq807x-zyxel-fit-uImage.itb.padded");
                        type = "firmware";
                        arch = "arm";
                        compression = "none";
                        hash@1 { algo = "crc32"; };
                };

                rootfs {
                        description = "openwrt-ipq-ipq807x_64-squashfs-root.img";
                        data = /incbin/("./openwrt-ipq-ipq807x_64-squashfs-root.img");
                        type = "firmware";
                        arch = "arm";
                        compression = "none";
                        hash@1 { algo = "crc32"; };
                };

                wififw {
                        description = "wifi_fw_squashfs_v2.img";
                        data = /incbin/("./wifi_fw_squashfs_v2.img");
                        type = "firmware";
                        arch = "arm";
                        compression = "none";
                        hash@1 { algo = "crc32"; };
                };

        };
};
```
